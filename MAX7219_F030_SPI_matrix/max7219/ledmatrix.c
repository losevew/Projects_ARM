//------------------------------------------------------------------------------
// This is Open source software. You can place this code on your site, but don't
// forget a link to my YouTube-channel: https://www.youtube.com/channel/UChButpZaL5kUUl_zTyIDFkQ
// Это программное обеспечение распространяется свободно. Вы можете размещать
// его на вашем сайте, но не забудьте указать ссылку на мой YouTube-канал 
// "Электроника в объектике" https://www.youtube.com/channel/UChButpZaL5kUUl_zTyIDFkQ
// Автор: Надыршин Руслан / Nadyrshin Ruslan
//------------------------------------------------------------------------------
#include "stm32f0xx.h"
#include "ledmatrix.h"
#include "max7219.h"


uint8_t ledmatrix_screenbuff[MAX7219_NUM * 8];


//==============================================================================
// Процедура инициализирует матрицу
//==============================================================================
void ledmatrix_init(void)
{
  max7219_init();

  // Выводим все max7219 из спящего режима
  max7219_set_run_onoff(MAX7219_ALL_IDX, 1);
  // Устанавливаем кол-во символов (или строк), подключенных к max7219
  max7219_set_scan_limit(MAX7219_ALL_IDX, 0x07);
  // Устанавливаем режим перекодирования кодов цифр перед выводом на индикатор (для матриц =0)
  max7219_set_decodemode(MAX7219_ALL_IDX, MAX7219_NO_DECODE);
  // Устанавливаем яркость индикаторов (от 0 до 15)
  max7219_set_intensity(MAX7219_ALL_IDX, 0x2);
  
  // Очищаем ОЗУ микросхем max7219, потому что сейчас в них может быть мусор
  ledmatrix_fill_screenbuff(0);
  ledmatrix_update_from_buff();
}
//==============================================================================


//==============================================================================
// Процедура управляет режимом Test матрицы
//==============================================================================
void ledmatrix_testmatrix(uint8_t TestOn)
{
  max7219_set_testmode_onoff(MAX7219_ALL_IDX, TestOn);
}
//==============================================================================


//==============================================================================
// Процедура устанавливает яркость матрицы. Диапазон 0-15
//==============================================================================
void ledmatrix_set_brightness(uint8_t Value)
{
  max7219_set_intensity(MAX7219_ALL_IDX, Value);
}
//==============================================================================


//==============================================================================
// Процедура заполняет буфер кадра значением FillValue
//==============================================================================
void ledmatrix_fill_screenbuff(uint8_t FillValue)
{
  for (uint16_t i = 0; i < (8 * MAX7219_NUM); i++)
    ledmatrix_screenbuff[i] = FillValue;
}
//==============================================================================


//==============================================================================
// Процедура сдвигает содержимое буфера кадра ВЛЕВО
// Самый правый столбец сохраняет при этом своё старое значение
//==============================================================================
void ledmatrix_ScrollLeft(void)
{
  for (uint16_t col = 1; col < (MAX7219_NUM * 8); col++)
	{
		ledmatrix_screenbuff[col - 1] = ledmatrix_screenbuff[col];
	}
}
//==============================================================================


//==============================================================================
// Процедура сдвигает содержимое буфера кадра ВПРАВО
// Самый левый столбец сохраняет при этом своё старое значение
//==============================================================================
void ledmatrix_ScrollRight(void)
{
  for (uint16_t col = (MAX7219_NUM * 8) - 1; col; col--)
	{
		ledmatrix_screenbuff[col] = ledmatrix_screenbuff[col - 1];	
	}
}
//==============================================================================


//==============================================================================
// Процедура обновляет состояние индикаторов в соответствии с буфером кадра ledmatrix_screenbuff
//==============================================================================
void ledmatrix_update_from_buff(void)
{
  uint16_t max7219_SpiBuff[MAX7219_NUM];

  for (uint8_t Digit = 0; Digit < 8; Digit++)
  {
    for (uint8_t i = 0; i < MAX7219_NUM; i++)
    {
      // Формирование слова для записи в max7219[i] в строку Digit
      uint8_t Data = 0;
      for (uint8_t Col = 0; Col < 8; Col++)
      {
        uint8_t bit = (ledmatrix_screenbuff[(i << 3) + Col] & (1 << Digit)) ? 1 : 0;
        Data |= (bit << (7 - Col));
      }
      max7219_SpiBuff[i] = Data | ((uint16_t) (Digit + 1) << 8);
    }
    
    // Записываем одну строку во все max7219
    max7219_sendarray(max7219_SpiBuff);
  }
}
//==============================================================================
