//------------------------------------------------------------------------------
// This is Open source software. You can place this code on your site, but don't
// forget a link to my YouTube-channel: https://www.youtube.com/channel/UChButpZaL5kUUl_zTyIDFkQ
// Это программное обеспечение распространяется свободно. Вы можете размещать
// его на вашем сайте, но не забудьте указать ссылку на мой YouTube-канал 
// "Электроника в объектике" https://www.youtube.com/channel/UChButpZaL5kUUl_zTyIDFkQ
// Автор: Надыршин Руслан / Nadyrshin Ruslan
//------------------------------------------------------------------------------
#include "stm32f0xx.h"
#include "max7219.h"




//==============================================================================
// Процедура инициализирует ножки, используемые интерфейсом обмена с max7219
// инициализирует SPI
// инициализирует интерфейс обмена с цепочкой max7219
//==============================================================================
void max7219_init(void)
{
	RCC->AHBENR |= RCC_AHBENR_GPIOAEN ;
	RCC->APB2ENR |= RCC_APB2ENR_SPI1EN ;
	
	 /* (1) Select AF mode (10) on  PA5, PA6, PA7 */
	/* (2) AF0 for SPI1 signals */
	GPIOA->MODER = (GPIOA->MODER &~( GPIO_MODER_MODER5 | GPIO_MODER_MODER6 | GPIO_MODER_MODER7))\
                  | ( GPIO_MODER_MODER5_1 | GPIO_MODER_MODER6_1 | GPIO_MODER_MODER7_1); /* (1) */
	GPIOA->AFR[0] = (GPIOA->AFR[0] &~( GPIO_AFRL_AFRL5 | GPIO_AFRL_AFRL6 | GPIO_AFRL_AFRL7)); /* (2) */
	
	MAX7219_PORT->OTYPER &= ~(CS_PIN_OTYP);
	MAX7219_PORT->OSPEEDR |= (CS_PIN_OSPEED) ;
	MAX7219_PORT->MODER |= (CS_PIN_MODE);
	

	/* (1) Master selection, BR: Fpclk/128  CPOL and CPHA at zero (rising first edge) */
	/* (2) Slave select output enabled, NSSP enabled, RXNE IT, 8-bit Rx fifo */
	/* (3) Enable SPI1 */
	SPI1->CR1 = SPI_CR1_MSTR | SPI_CR1_BR_2 | SPI_CR1_BR_1; /* (1) */
	SPI1->CR2 = SPI_CR2_SSOE | SPI_CR2_FRXTH | SPI_CR2_DS_2 | SPI_CR2_DS_1 | SPI_CR2_DS_0; /* (2) */
	SPI1->CR1 |= SPI_CR1_SPE; /* (3) */
}
//==============================================================================


//==============================================================================
// Процедура отправляет команду с данным в один или во все max7219 в цепочке
//==============================================================================
void max7219_send(uint8_t MAX_Idx, uint8_t Cmd, uint8_t Data)
{
  uint16_t max7219_SpiBuff[MAX7219_NUM];
  uint16_t Word = Data | ((uint16_t) Cmd << 8);
  
  for (uint8_t i = 0; i < MAX7219_NUM; i++)
  {
    if (MAX_Idx == 0xFF)  // Нужно записать во все max7219 в цепочке
      max7219_SpiBuff[i] = Word;
    else                  // Нужно записать только в один max7219
    {
      if (i == MAX_Idx)         // Та микросхема max7219, в которую нужно записать команду/данные
        max7219_SpiBuff[i] = Word;
      else                      // max7219, которому нет данных на запись
        max7219_SpiBuff[i] = 0x00 | ((uint16_t) MAX7219_CMD_NO_OP << 8);
    }
  }
  
  // Пишем пачку слов во все подключенные max7219
  max7219_sendarray(max7219_SpiBuff);
}
//==============================================================================


//==============================================================================
// Процедура отправляет массив команд в max7219
//==============================================================================
void max7219_sendarray(uint16_t *pArray)
{
  MAX7219_CS0;
  
  for (uint8_t i = 0; i < MAX7219_NUM; i++)
   { 
		max7219_send16bit(*(pArray++));
   }
  
  MAX7219_CS1;
}
//==============================================================================


//==============================================================================
// Процедура отправляет 16-битное слово по SPI
//==============================================================================
void max7219_send16bit(uint16_t Word)
{
  if ((SPI1->SR & SPI_SR_TXE) == SPI_SR_TXE) /* Test Tx empty */
		{
			/* Will inititiate 8-bit transmission if TXE */
			*(uint8_t *)&(SPI1->DR) = hibyte(Word);
			while (!(SPI1->SR & SPI_SR_RXNE));
			(void)SPI1->DR;
			*(uint8_t *)&(SPI1->DR) = lobyte(Word);
			while (!(SPI1->SR & SPI_SR_RXNE));
			(void)SPI1->DR;
			//SPI1->SR |= SPI_SR_TXE;
		}
}
//==============================================================================


//==============================================================================
// Процедура устанавливает режим декодирования символов в 1 или во всех max7219
//==============================================================================
void max7219_set_decodemode(uint8_t MAX_Idx, uint8_t DecodeMode)
{
  max7219_send(MAX_Idx, MAX7219_CMD_DECODE_MODE, DecodeMode);
}
//==============================================================================


//==============================================================================
// Процедура устанавливает яркость в 1 или во всех max7219
//==============================================================================
void max7219_set_intensity(uint8_t MAX_Idx, uint8_t Intensity)
{
  if (Intensity > 15)
    Intensity = 15;
  
  max7219_send(MAX_Idx, MAX7219_CMD_INTENSITY, Intensity);
}
//==============================================================================


//==============================================================================
// Процедура устанавливает кол-во знаков/строк в 1 или во всех max7219
//==============================================================================
void max7219_set_scan_limit(uint8_t MAX_Idx, uint8_t Limit)
{
  if (Limit > 7)
    Limit = 7;
  
  max7219_send(MAX_Idx, MAX7219_CMD_SCAN_LIMIT, Limit);
}
//==============================================================================


//==============================================================================
// Процедура включает/выключает max7219. После подачи питания он выключен
//==============================================================================
void max7219_set_run_onoff(uint8_t MAX_Idx, uint8_t On)
{
  if (On)
    On = 1;
  
  max7219_send(MAX_Idx, MAX7219_CMD_SHUTDOWN, On);
}
//==============================================================================


//==============================================================================
// Процедура включает/выключает тестовый режим max7219 (горят все индикаторы)
//==============================================================================
void max7219_set_testmode_onoff(uint8_t MAX_Idx, uint8_t On)
{
  if (On)
    On = 1;
  
  max7219_send(MAX_Idx, MAX7219_CMD_DISP_TEST, On);
}
//==============================================================================




